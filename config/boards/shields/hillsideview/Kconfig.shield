## config/boards/shields/hillsideview/Kconfig.shield
```kconfig
# Copyright (c) 2022-2026 The ZMK Contributors
# SPDX-License-Identifier: MIT

config SHIELD_HILLSIDEVIEW_LEFT
    def_bool $(shields_list_contains,hillsideview_left)

config SHIELD_HILLSIDEVIEW_RIGHT
    def_bool $(shields_list_contains,hillsideview_right)
```

## config/west.yml
```yaml
manifest:
  remotes:
    - name: zmkfirmware
      url-base: https://github.com/zmkfirmware
    - name: swapper
      url-base: https://github.com/caksoylar
    - name: urob
      url-base: https://github.com/urob
    - name: nice!view-modules
      url-base: https://github.com/dee-tree
    - name: geeksville
      url-base: https://github.com/geeksville
  projects:
    - name: zmk
      remote: zmkfirmware
      revision: v0.3
      import: app/west.yml

    - name: zmk-smart-toggle
      remote: swapper
      revision: v0.3

    - name: zmk-auto-layer
      remote: urob
      revision: v0.3 # Should match ZMK release.

    - name: nice-view-gem
      remote: nice!view-modules
      revision: v0.3

    - name: cirque-input-module
      remote: geeksville
      revision: main
  self:
    path: config
```
